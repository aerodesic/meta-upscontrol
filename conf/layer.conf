## conf/layer.conf
```bitbake
# We have a conf and classes directory, add to BBPATH
BBPATH .= ":${LAYERDIR}"

# We have a recipes-* directories, add to BBFILES
BBFILES += "${LAYERDIR}/recipes-*/*/*.bb \
    ${LAYERDIR}/recipes-*/*/*.bbappend"

BBFILE_COLLECTIONS += "meta-upscontrol"
BBFILE_PATTERN_meta-upscontrol = "^${LAYERDIR}/"
BBFILE_PRIORITY_meta-upscontrol = "6"

LAYERSERIES_COMPAT_meta-upscontrol = "sumo thud warrior zeus dunfell gatesgarth"
```
